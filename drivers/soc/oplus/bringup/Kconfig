## drivers/soc/oplus/bringup/Kconfig
```kconfig
# SPDX-License-Identifier: GPL-2.0-only
config OPLUS_BRINGUP_STAGE_RESET
	bool "Reboot at a configurable kernel boot stage for bring-up bisection"
	depends on ARM64
	default n
	help
	  Trigger an immediate warm PSCI system reset when the kernel reaches
	  the boot stage selected by the "bringup.reset_at=<N>" early kernel
	  command-line parameter (1..9; 0 or omitted disables the reset).
	  Each stage reached is also logged at KERN_EMERG for pstore/ramoops
	  capture. Use this on command-mode DSI panels without UART or working
	  USB to bisect early boot hangs by observing whether the device
	  reboots.
```
